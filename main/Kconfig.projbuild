## main/Kconfig.projbuild
```kconfig
menu "Fuel injection estimate"

    comment "Engine geometry (defaults: ZongShen Carrera 125, 57.3 x 48.4 mm single)"

    config FUEL_BORE_UM
        int "Bore (micrometres)"
        range 10000 200000
        default 57300

    config FUEL_STROKE_UM
        int "Stroke (micrometres)"
        range 10000 200000
        default 48400

    config FUEL_CYLINDERS
        int "Number of cylinders"
        range 1 12
        default 1

    config FUEL_STROKES_PER_CYCLE
        int "Strokes per cycle (4 = four-stroke, 2 = two-stroke)"
        range 2 4
        default 4

    comment "Fuel source"

    choice FUEL_SOURCE
        prompt "Where fuel flow comes from"
        default FUEL_SOURCE_INJECTOR
        help
            Injection value: the ECU's own injection value (CAN 0x110 B5-B6)
            times the constant below. This follows what the ECU really
            injects, including enrichment, trims and fuel cut. Falls back to
            the speed-density model whenever the broadcast is missing.
            Speed-density: estimate from MAP, intake temperature, RPM, O2 and
            the volumetric efficiency below.

        config FUEL_SOURCE_INJECTOR
            bool "ECU injection value x constant"
        config FUEL_SOURCE_SPEED_DENSITY
            bool "Speed-density model only"
    endchoice

    config FUEL_INJ_LPH_PER_UNIT_X1000
        int "Fuel per unit of the ECU's injection value (L/h x1000)"
        range 10 2000
        default 180
        help
            The ECU's injection value (CAN 0x110 B5-B6, shown as INJ) behaves
            as a fuel rate on the ZS125, not a pulse time: fuel flow in L/h is
            this constant / 1000 times the value. 180 comes from a week of
            riding (2026-10-06..13): it puts Artur's usual 2.5 L/100 km in
            range and gives a smooth VE curve topping at ~0.93. Fuel scales
            1:1 with it: if a fill-up shows the trip reading 10 % high, lower
            it by 10 %. The serial "TRIP" line logs value_s, the sum needed
            to refit it exactly: constant = litres * 3600 / value_s.

    comment "Model constants"

    config FUEL_VE_PERCENT
        int "Volumetric efficiency (%)"
        range 30 120
        default 80
        help
            Fraction of the swept volume actually filled with air at
            manifold conditions. A small two-valve 125 cc engine is roughly
            70-85 %. This single constant is the largest error source and
            doubles as the calibration factor: fuel scales 1:1 with it, so if
            the dashboard reads 10 % high against a fill-to-fill check,
            lower it by 10 %.

    config FUEL_STOICH_AFR_X100
        int "Stoichiometric air/fuel ratio x100"
        range 500 2000
        default 1470
        help
            1470 for pure petrol, about 1410 for E10.

    config FUEL_DENSITY_G_PER_L
        int "Fuel density (g/L)"
        range 600 1000
        default 745

    choice FUEL_LAMBDA_SOURCE
        prompt "Lambda source"
        default FUEL_LAMBDA_NARROWBAND
        help
            Narrowband uses the time-averaged O2 sensor 1 voltage (OBD PID
            0x14) as a coarse lambda correction (about 0.9-1.1). Choose
            "assume stoichiometric" to ignore the O2 sensor entirely.

        config FUEL_LAMBDA_NARROWBAND
            bool "Narrowband O2 sensor 1 (PID 0x14)"
        config FUEL_LAMBDA_ASSUME_STOICH
            bool "Assume stoichiometric (lambda = 1.0)"
    endchoice

    config FUEL_OUTPUT_TAU_MS
        int "Output smoothing time constant (ms)"
        range 0 5000
        default 300

    config FUEL_LAMBDA_TAU_MS
        int "O2 averaging time constant (ms)"
        range 0 20000
        default 3000

    comment "Display units and averages"

    config FUEL_MOVING_RPM
        int "RPM at which the instant reading switches to L/100km"
        range 500 15000
        default 2500
        help
            Below this the bike is taken to be stopped or idling and the
            instant reading shows L/h. L/100km also needs a valid road speed.

    config FUEL_MOVING_HYSTERESIS_RPM
        int "Unit switch hysteresis (RPM)"
        range 0 2000
        default 150
        help
            Switches back to L/h only below (switch RPM - this), so cruising
            right at the threshold does not make the unit flicker.

    config FUEL_MIN_SPEED_KMH
        int "Minimum road speed for L/100km (km/h)"
        range 1 50
        default 5

    config FUEL_AVG_MIN_DISTANCE_M
        int "Distance before the average shows L/100km (metres)"
        range 0 10000
        default 500
        help
            Until then the since-start average is shown in L/h.

    comment "Deceleration fuel cut detection"

    config FUEL_CUT_MIN_RPM
        int "Minimum RPM"
        range 500 15000
        default 1800

    config FUEL_CUT_MAX_THROTTLE_PCT
        int "Maximum throttle (%)"
        range 0 20
        default 2

    config FUEL_CUT_MAX_O2_MV
        int "Maximum O2 sensor voltage (mV)"
        range 0 450
        default 150

endmenu

menu "Dashboard thresholds"

    comment "Cylinder head temperature colours (C)"

    config DASH_CHT_BLUE_BELOW_C
        int "Blue (cold) below"
        range 0 200
        default 80

    config DASH_CHT_GREEN_BELOW_C
        int "Green (normal) below"
        range 0 250
        default 135

    config DASH_CHT_ORANGE_BELOW_C
        int "Orange (warm) below; red from here"
        range 0 250
        default 150
        help
            Red means "too hot, no damage yet, stop when you can".

    config DASH_CHT_CRITICAL_C
        int "Stop-now alert (black on flashing red) at"
        range 0 300
        default 165
        help
            The emergency level: stop the engine now. Set it above the
            hottest reading seen in hard but healthy riding (hot day, long
            climb, traffic) and below where damage starts. The default
            assumes a head-casting sensor on the intake side, which reads
            cooler than the exhaust side and the spark plug seat.

    config DASH_CHT_CRITICAL_HYSTERESIS_C
        int "Stop-now alert clears this many degrees below"
        range 0 30
        default 5

    config DASH_CHT_CRITICAL_CONFIRM_MS
        int "Stop-now alert needs the reading to hold this long (ms)"
        range 0 10000
        default 1000
        help
            Filters a single bad sample so it can't trigger the alert.

    comment "RPM"

    config DASH_RPM_GAUGE_MAX
        int "RPM gauge full scale"
        range 1000 20000
        default 10500

    config DASH_RPM_SHIFT
        int "Shift warning (flashing) at or above"
        range 1000 20000
        default 10000

endmenu

menu "PID scan (discovery test)"

    config PID_SCAN_AT_BOOT
        bool "Start the PID scan at boot"
        default n
        help
            Asks every Mode 01 PID (0x00-0xFF) regardless of the ECU's
            supported-PID bitmaps, then keeps watching the ones that answer
            and tallies all other CAN traffic. Reports go to the serial log
            every report period. Without this the scan is started over BLE
            with the command SCAN (also SCAN REPORT and SCAN STOP).

    config PID_SCAN_GAP_MS
        int "Pause between scan requests (ms)"
        range 0 1000
        default 40
        help
            Leaves the bus to the dashboard's own polling between scan
            requests, so the display keeps updating during the test.

    config PID_SCAN_REPORT_PERIOD_S
        int "Report period (s)"
        range 5 600
        default 30

endmenu

menu "Boot screen"

    config DASH_SPLASH_HOLD_MS
        int "How long the boot screen stays up (ms)"
        range 0 10000
        default 2500
        help
            The boot screen (sprite, firmware version, authors) is held this
            long before the dashboard self-test starts. The boot record
            (boot_diag) is still kept in NVS and logged on the serial port
            at every start; it is no longer drawn on the screen.

endmenu

menu "Speed, gears, tank and phone link"

    comment "Defaults only: each value can be changed from the phone app (PARAM SET), kept in NVS"

    choice SPEED_FUEL_SOURCE
        prompt "Speed source for the fuel totals"
        default SPEED_FUEL_SOURCE_GPS_EXT
        help
            Every speed source stays visible on its own (phone app, logs);
            this only picks the one that feeds L/100km, the distance and
            the range. When it drops out, the gear estimate stands in, then
            the recent average is held (see below).

        config SPEED_FUEL_SOURCE_GPS_EXT
            bool "Phone GPS over BLE (Vel_GPS_Ext)"
        config SPEED_FUEL_SOURCE_WHEEL
            bool "Wheel sensor (Vel_Roda)"
        config SPEED_FUEL_SOURCE_GPS_INT
            bool "GPS module on the board (Vel_GPS_Int)"
        config SPEED_FUEL_SOURCE_GEAR
            bool "RPM x learnt gear ratio (Vel_Mudanca)"
    endchoice

    config SPEED_HOLD_S
        int "Hold the recent average speed through drop-outs for (s)"
        range 0 600
        default 120
        help
            Tunnels, GPS loss: while the engine is pulling, distance keeps
            accumulating at the average of the last ~20 s for this long.
            The gear estimate, once learnt, takes priority over this.

    config GEAR_COUNT
        int "Number of gears"
        range 1 7
        default 5

    config TANK_CAPACITY_DL
        int "Fuel tank capacity (decilitres)"
        range 10 500
        default 120
        help
            Level after a "FILL FULL". Set the real capacity from the app.

    config RANGE_BASELINE_X100
        int "Consumption for the range before 20 km since a fill (L/100km x100)"
        range 50 3000
        default 265

endmenu
```
